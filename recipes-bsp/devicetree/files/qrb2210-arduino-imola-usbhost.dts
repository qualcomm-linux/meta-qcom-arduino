// SPDX-License-Identifier: (GPL-2.0+ OR BSD-3-Clause)
/*
 * Copyright (c) Qualcomm Technologies, Inc. and/or its subsidiaries.
 */

/* linux-arduino splits the board DT into a base DTS and overlays */
#if __has_include("qrb2210-arduino-imola-base.dts")
#include "qrb2210-arduino-imola-base.dts"
#else
#include "qrb2210-arduino-imola.dts"
#endif

#include <linux/version.h>
#if LINUX_VERSION_CODE >= KERNEL_VERSION(7,4,0)
&usb {
#else
&usb_dwc3 {
#endif
	dr_mode = "host";
	/delete-property/ usb-role-switch;
};
